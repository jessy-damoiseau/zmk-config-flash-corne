## boards/shields/corne_touchpad/Kconfig.defconfig
```kconfig
if SHIELD_CORNE_TOUCHPAD_LEFT || SHIELD_CORNE_TOUCHPAD_RIGHT

config ZMK_POINTING
    default y

config I2C
    default y

endif
```

## boards/shields/corne_touchpad/Kconfig.shield
```kconfig
config SHIELD_CORNE_TOUCHPAD_LEFT
    def_bool $(shields_list_contains,corne_touchpad_left)

config SHIELD_CORNE_TOUCHPAD_RIGHT
    def_bool $(shields_list_contains,corne_touchpad_right)
```
